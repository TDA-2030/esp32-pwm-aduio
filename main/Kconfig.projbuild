## main/Kconfig.projbuild
```kconfig
menu "Example Configuration"

    config LEFT_CHANNEL_GPIO
        int "left channel GPIO number"
        range 0 34
        default 17
        help
            GPIO number (IOxx) to output left channel audio.

    config RIGHT_CHANNEL_GPIO
        int "right channel GPIO number"
        range 0 34
        default 18
        help
            GPIO number (IOxx) to output right channel audio.

    config AUDIO_SAMPLE_RATE
        int "Audio sample Rate"
        range 10000 48000
        default 44100
        help
            Played audio at this sample rate

endmenu
```

## sdkconfig.defaults
```kconfig
CONFIG_ESP32_DEFAULT_CPU_FREQ_240=y


CONFIG_FREERTOS_UNICORE=n
CONFIG_FREERTOS_HZ=500
#
# Partition Table
#
CONFIG_PARTITION_TABLE_CUSTOM=y
CONFIG_PARTITION_TABLE_CUSTOM_FILENAME="partitions.csv"
CONFIG_PARTITION_TABLE_FILENAME="partitions.csv"


CONFIG_FREERTOS_GENERATE_RUN_TIME_STATS=y
CONFIG_FREERTOS_RUN_TIME_STATS_USING_ESP_TIMER=y


CONFIG_ESPTOOLPY_FLASHSIZE_4MB=y
CONFIG_FLASHMODE_QIO=y
CONFIG_ESPTOOLPY_FLASHFREQ_80M=y
CONFIG_LWIP_IRAM_OPTIMIZATION=y

CONFIG_LEFT_CHANNEL_GPIO=25
CONFIG_RIGHT_CHANNEL_GPIO=26
```
